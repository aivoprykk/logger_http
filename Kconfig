## Kconfig
```kconfig
menu "Logger HTTP Module Configuration"
    config LOGGER_HTTP_ENABLED
        bool "Enable Logger HTTP Module"
        default y
        help
            Enable Logger HTTP Module

    if LOGGER_HTTP_ENABLED

    config MDNS_HOST_NAME
        string "mDNS Host Name"
        default "esp"
        help
            Specify the domain name used in the mDNS service.
            Note that webapp also take it as a part of URL where it will send GET/POST requests to.

    config WEB_SERVER_APPEND_MAC_TO_HOSTNAME
        bool "Append MAC address to hostname"
        default y
        help
            Append the last three octets of the device's MAC address to the mDNS hostname to ensure uniqueness.

    menu "HTTP Server Configuration"
        config WEB_SERVER_TASK_STACK_SIZE
            int "Http server Task stack size in bytes"
            default 3840 if IDF_TARGET_ESP32S3
            default 3456
            help
                HTTP server task stack size in bytes

        config WEB_SERVER_ASYNC_WORKER_ENABLED
            bool "Enable Async Worker Tasks"
            default y
            help
                Enable asynchronous worker tasks to handle long-running HTTP requests.

        if WEB_SERVER_ASYNC_WORKER_ENABLED

        config WEB_SERVER_ASYNC_WORKER_TASK_STACK_SIZE
            int "Async workers Task stack size in bytes"
            default 3840
            help
                Asynchronous worker task stack size in bytes

        config WEB_SERVER_NUM_ASYNC_WORKERS
            int "Number of async request handler tasks"
            default 4 if IDF_TARGET_ESP32S3
            default 1
            help
                Number of asynchronous worker tasks to handle long-running HTTP requests.
        endif

    endmenu
    menu "OTA Configuration"

    config USE_OTA
        bool "Use OTA via webserver"
        default y
        help
            Use OTA functionality to update firmware over the air.

    config OTA_USE_AUTO_UPDATE
        bool "Use auto update firmware checks"
        depends on USE_OTA
        default y
        help
            Use auto update firmware checks via background task.

    if OTA_USE_AUTO_UPDATE

    config OTA_AUTO_UPDATE_TASK_STACK_SIZE
            int "OTA Task stack size in bytes"
            default 3840
            help
                OTA task stack size in bytes

    config OTA_API_SERVER_URL
        string "OTA api server name"
        default "esplogger.majasa.ee"
        help
            Hostname of the OTA api server.

    config OTA_CHECK_INTERVAL
        int "Interfal to check updates in minutes"
        default 1
        help
            Interval to check updates

    config OTA_SKIP_COMMON_NAME_CHECK
        bool "Skip server certificate CN fieldcheck"
        default n
        help
            This allows you to skip the validation of OTA server certificate CN field.

    config OTA_SKIP_VERSION_CHECK
        bool "Skip firmware version check"
        default n
        help
            This allows you to skip the firmware version check.

    config OTA_RECV_TIMEOUT
        int "OTA Receive Timeout"
        default 5000
        help
            Maximum time for reception

    config OTA_ENABLE_PARTIAL_HTTP_DOWNLOAD
        bool "Enable partial HTTP download"
        default n
        help
            This enables use of Range header in esp_https_ota component.
            Firmware image will be downloaded over multiple HTTP requests.

    config OTA_HTTP_REQUEST_SIZE
        int "HTTP request size"
        default MBEDTLS_SSL_IN_CONTENT_LEN
        depends on OTA_ENABLE_PARTIAL_HTTP_DOWNLOAD
        help
            This options specifies HTTP request size. Number of bytes specified
            in this option will be downloaded in single HTTP request.

    endif
    endmenu
    choice
        bool "Default log verbosity"
        default LOGGER_HTTP_LOG_LEVEL_ERROR
        help
            Specify how important log should be added.
        config LOGGER_HTTP_LOG_LEVEL_TRACE
            bool "TRACE: Log more to give detailed information"
        config LOGGER_HTTP_LOG_LEVEL_DEBUG
            bool "DEBUG: Log general debug info"
        config LOGGER_HTTP_LOG_LEVEL_INFO
            bool "INFO: Log important events"
        config LOGGER_HTTP_LOG_LEVEL_WARN
            bool "WARN: Log if something unwanted happened but didn't cause a problem"
        config LOGGER_HTTP_LOG_LEVEL_ERROR
            bool "ERROR: Only critical issues, when the system may fail"
        config LOGGER_HTTP_LOG_LEVEL_USER
            bool "USER: Only logs added by the user"
        config LOGGER_HTTP_LOG_LEVEL_NONE
            bool "NONE: Do not log anything"
    endchoice
    config LOGGER_HTTP_LOG_LEVEL
        int
        default 0 if LOGGER_HTTP_LOG_LEVEL_TRACE
        default 1 if LOGGER_HTTP_LOG_LEVEL_DEBUG
        default 2 if LOGGER_HTTP_LOG_LEVEL_INFO
        default 3 if LOGGER_HTTP_LOG_LEVEL_WARN
        default 4 if LOGGER_HTTP_LOG_LEVEL_ERROR
        default 5 if LOGGER_HTTP_LOG_LEVEL_USER
        default 6 if LOGGER_HTTP_LOG_LEVEL_NONE
    endif
endmenu
```
